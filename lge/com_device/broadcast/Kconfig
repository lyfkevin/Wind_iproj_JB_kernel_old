## lge/com_device/broadcast/Kconfig
```kconfig
#
# Broadcast Device Driver Support
#

menu "BROADCAST_DEVICE"

config LGE_BROADCAST_DCM
	bool "LGE broacast device"
	default n
	depends on MACH_LGE_325_BOARD_DCM
	help
	  Select this if you want to use broadcast service

#for tag - added by mo2chunghan.lee@lge.com, 11/13/2012 ===
config LGE_BROADCAST_ONESEG
    bool "LGE broacast device"
    default n
    help
      Select this if you want to use broadcast service
#==========================================================
	  
endmenu
```

## lge/com_device/broadcast/fc8101/Kconfig
```kconfig
#
# FC8100_DEVICE subsystem configuration
#

#menu "FC8100 support"

config FC8100_ISDB_T
	default n
	---help---
	  This driver implements the front-end of the Xen virtual
	  keyboard and mouse device driver.  It communicates with a back-end
	  in another domain.
  
#endmenu
```

## lge/com_device/broadcast/fc8101/drv/Kconfig
```kconfig
#
# LG2102_DEVICE subsystem configuration
#

#menu "FC8101 support"

config FC8100_ISDB_T
	default n
	---help---
	  This driver implements the front-end of the Xen virtual
	  keyboard and mouse device driver.  It communicates with a back-end
	  in another domain.
  
#endmenu
```

## lge/com_device/felica/Kconfig
```kconfig
#platform.team@lge.com	2011.01

comment "LGE Felica selection"

config LGE_FELICA
	bool "Felica driver"
    depends on MACH_LGE_I_BOARD_DCM || MACH_LGE_325_BOARD_DCM
	default n
	---help---
	LGE Felica related change	
```

## lge/lge_board/Kconfig
```kconfig
#platform.team@lge.com	2011.01

config MACH_LGE_I_BOARD
       bool "LGE_I_BOARD"
       depends on ARCH_MSM8X60
       default n
       ---help---
         LGE I-project. 

choice
	prompt "LGE board type"
	default MACH_LGE_I_BOARD_ATNT 

config MACH_LGE_I_BOARD_VZW
       bool "LGE_I_BOARD_VZW"
       depends on MACH_LGE_I_BOARD
       ---help---
         LGE I-project for VZW. 

config MACH_LGE_I_BOARD_ATNT
       bool "LGE_I_BOARD_ATNT"
       depends on MACH_LGE_I_BOARD
       ---help---
         LGE I-project for AT&T.

config MACH_LGE_I_BOARD_SKT
       bool "LGE_I_BOARD_SKT"
       depends on MACH_LGE_I_BOARD
       ---help---
         LGE I-project for SKT.         

config MACH_LGE_I_BOARD_LGU
       bool "LGE_I_BOARD_LGU"
       depends on MACH_LGE_I_BOARD
       ---help---
         LGE I-project for LGU.

config MACH_LGE_I_BOARD_DCM
       bool "LGE_I_BOARD_DCM"
       depends on MACH_LGE_I_BOARD
       ---help---
         LGE I-project for DoCoMo.         

config MACH_LGE_IJB_BOARD_SKT
       bool "LGE_IJB_BOARD_SKT"
       depends on MACH_LGE_I_BOARD
       ---help---
         LGE IJB-project for SKT.         

config MACH_LGE_IJB_BOARD_LGU
       bool "LGE_IJB_BOARD_LGU"
       depends on MACH_LGE_I_BOARD
       ---help---
         LGE IJB-project for LGU.         

config MACH_LGE_HDK_8x60
       bool "LGE_I_BOARD_HDK_8x60"
       depends on MACH_LGE_I_BOARD
       ---help---
         LGE I-project for HDK_8x60.

endchoice
 
config MACH_LGE_325_BOARD
       bool "LGE_325_BOARD"
       depends on ARCH_MSM8X60
       default y
       ---help---
         LGE 325-project. 

choice
	prompt "LGE 325 board type"
	default MACH_LGE_325_BOARD_SKT

config MACH_LGE_325_BOARD_VZW
       bool "LGE_325_BOARD_VZW"
#Unblocked by mo2chunghan.lee@lge.com, Fusion2_JB-11/06/2012
       depends on MACH_LGE_325_BOARD
       ---help---
         LGE 325-project for VZW. 

config MACH_LGE_325_BOARD_DCM
       bool "LGE_325_BOARD_DCM"
       depends on MACH_LGE_325_BOARD
       ---help---
         LGE 325-project for DCM. 

config MACH_LGE_325_BOARD_SKT
       bool "LGE_325_BOARD_SKT"
       depends on MACH_LGE_325_BOARD
       ---help---
         LGE 325-project for SKT.

config MACH_LGE_325_BOARD_LGU
       bool "LGE_325_BOARD_LGU"
       depends on MACH_LGE_325_BOARD
       ---help---
         LGE 325-project for LGU.         
endchoice

source "lge/lge_board/batman/batman_vzw/Kconfig"

#added by mo2chunghan.lee@lge.com - Fusion2_JB-11/06/2012 --
config MACH_LGE_120_BOARD
       bool "LGE_120_BOARD"
       depends on ARCH_MSM8X60
       ---help---
         LGE 120 project.

choice
    prompt "LGE 120 board type"
    default MACH_LGE_120_BOARD_SKT

config MACH_LGE_120_BOARD_SKT
       bool "LGE_120_BOARD_SKT"
       depends on MACH_LGE_120_BOARD
       ---help---
         LGE 120-project for SKT.

config MACH_LGE_120_BOARD_KT
       bool "LGE_120_BOARD_KT"
       depends on MACH_LGE_120_BOARD
       ---help---
         LGE 120-project for KT.

endchoice
# ----------------------------------------------------------
```

## lge/lge_board/batman/batman_vzw/Kconfig
```kconfig
menu "LGE batman vzw board config"

config TEMP_VZW_CONFIG
	boolean "TEMP Config for Batman Verzion"
	default n
	---help---
		Temp config for bring up Batman verizon

### "Kernel"
### BATMAN_VZW_KERNEL_xxx

config BATMAN_VZW_KERNEL_GPIO
	boolean "Support batman VZW GPIO"
	default n
	---help---
		LGE GPIO Config for BATMAN for VZW

config BATMAN_VZW_KERNEL_BOARD_REV
	boolean "Support batman VZW PMIC MPP"
	default n
	---help---
		LGE PMIC MPP Config for BATMAN for VZW
### "Power"
### BATMAN_VZW_KERNEL_xxx
config BATMAN_VZW_HALLIC
	boolean "Support batman VZW Hall IC"
	default n
	---help---
		LGE Hall IC Config for BATMAN for VZW

config BATMAN_VZW_FUEL_GAUGE
	boolean "Support batman VZW Fuel Gauge"
	default n
	---help---
		LGE Fuel Gauge Config for BATMAN for VZW

config BATMAN_VZW_POWER_BATT_THRM_SCENARIO
	boolean "Support batman VZW Battery Thermistor Scenario"
	default n
	---help---
		LGE Battery Thermistor Config for BATMAN for VZW

config BATMAN_VZW_POWER_BATT_CHARGER
	boolean "Support batman VZW Battery Charging"
	default n
	---help---
		LGE Battery Charging Config for Batman for VZW

### "Display"
### BATMAN_VZW_DISPLAY_xxx

### "MHL"
### BATMAN_VZW_MHL_xxx

### "AUDIO"
### BATMAN_VZW_AUDIO_xxx

### "INPUT"
### BATMAN_VZW_INPUT_xxx

### "SENSOR"
### BATMAN_VZW_SENSOR_xxx
config BATMAN_VZW_SENSOR_ACCEL
	boolean "Support batman VZW Accelerometer Sensor"
	default n
	---help---
		LGE Accelerometer Sensor Config for BATMAN for VZW
		
config BATMAN_VZW_SENSOR_COMPASS
	boolean "Support batman VZW Compass Sensor"
	default n
	---help---
		LGE Compass Sensor Config for BATMAN for VZW

config BATMAN_VZW_SENSOR_GYRO
	boolean "Support batman VZW Gyro Sensor"
	default n
	---help---
		LGE Gyro Sensor Config for BATMAN for VZW

config BATMAN_VZW_SENSOR_LIGHT
	boolean "Support batman VZW Light Sensor"
	default n
	---help---
		LGE Light Sensor Config for BATMAN for VZW

config BATMAN_VZW_SENSOR_PROXIMITY
	boolean "Support batman VZW Proximity Sensor"
	default n
	---help---
		LGE Proximity Sensor Config for BATMAN for VZW
config LGE_LOG_SERVICE
    bool "Support LGE log service"
    default n
    ---help---
        Support LGE log service. The author of this patch is cs77.ha@lge.com

config BATMAN_VZW_POWER_ON_OFF
    bool "Support batman VZW Power On/Off"
    default n
    ---help---
		LGE Power On/Off Test Ofr Batman VZW

config BATMAN_VZW_XO_VOTER_FOR_EVDO
	default n
    bool "LGE_XO_VOTER_FOR_EVDO"
    ---help---
        LGE_PM_IGNORE_BATT_THERM_FOR_EVENTS

### "USB"
### BATMAN_VZW_USB_xxx

### "MODEM"
### BATMAN_VZW_MODEM_xxx

### "DOWNLOAD"
### BATMAN_VZW_DOWNLOAD_xxx

### "MAIN_CAMERA"
### BATMAN_VZW_MAIN_CAMERA_xxx

### "VT_CAMERA"
### BATMAN_VZW_VT_CAMERA_xxx

### "FOTA_UA"
### BATMAN_VZW_FOTA_UA_xxx
endmenu
```
